## app/Kconfig
```kconfig
mainmenu "Zephyr course application"

menuconfig APP_LED_SUBSYSTEM
    bool "LED Subsystem"
    default y

if APP_LED_SUBSYSTEM

choice APP_LED_BLINK_SLEEP
    prompt "LED blink sleep time"
    default APP_LED_SLEEP_MEDIUM

config APP_LED_SLEEP_FAST
    bool "0.5s (fast)"

config APP_LED_SLEEP_MEDIUM
    bool "1s (medium)"

config APP_LED_SLEEP_SLOW
    bool "2s (slow)"

endchoice

menuconfig APP_LED_ADVANCED
    bool "Advanced LED settings"
    default n

if APP_LED_ADVANCED

config APP_LED_BRIGHTNESS
    int "LED brightness (0-100)"
    range 0 100
    default 100

config APP_LED_FADE_DURATION
    int "LED fade duration (ms)"
    range 0 10000
    default 500

menu "Expert settings"

config APP_LED_DEBUG
    bool "Enable LED debugging"

config APP_LED_CUSTOM_PATTERN
    bool "Custom blink pattern"

endmenu

endif

endif

source "Kconfig.zephyr"
```

## boards/acme/my_board/board.yml
```yaml
board:
  name: my_board
  full_name: Nucleo F401RE
  vendor: st
  socs:
    - name: stm32f401xe
```

## boards/acme/my_scratch_board/Kconfig.my_scratch_board
```kconfig
# SPDX-License-Identifier: Apache-2.0

config BOARD_MY_SCRATCH_BOARD
	select SOC_STM32F401XE
```

## boards/acme/my_scratch_board/board.yml
```yaml
board:
  name: my_scratch_board
  full_name: My Scratch Board
  vendor: st
  socs:
    - name: stm32f401xe
```

## led_sensor_module/Kconfig
```kconfig
config LED_SENSOR
	bool "On-board LED exposed as a sensor"
	default y
	depends on DT_HAS_OUR_LED_SENSOR_ENABLED
	depends on SENSOR
	select GPIO
```

## led_sensor_module/dts/bindings/sensor/our,led-sensor.yaml
```yaml
description: Simple on-board LED exposed through the sensor API

compatible: "our,led-sensor"

include: base.yaml

properties:
  led-gpios:
    type: phandle-array
    required: true
```
